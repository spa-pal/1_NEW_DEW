LEDR equ 0                          ; RED led 
LEDG equ 1                          ; GREEN led 
LEDY equ 2                          ; YELLOW led 
I2CC equ 3                          ; I2C Clock pin 
I2CD equ 4                          ; I2C Data pin 
RTSA equ 5                          ; RTS channel a 
CTSA equ 6                          ; CTS channel a 
DTRA equ 7                          ; DTR channel a 
DCDA equ 8                          ; DCD channel a 
RVAA equ 9                          ; 232/485 selection channel a 
TXOFFA equ 10                       ; "transmitter off" channel a 
RTSB equ 11
CTSB equ 12
DTRB equ 13
DCDB equ 14
RVAB equ 15
TXOFFB equ 16
RESBUT equ 17                       ; "reset" button (soft reset) 
RS485_SEL equ 18
RS485_2W equ 19
TRIG1 equ 20
TRIG2 equ 21
TRIG3 equ 22
DEFAULT equ 23
RS485_4W equ 24
RS485_SEL_A equ 25
RS485_2W_A equ 26

