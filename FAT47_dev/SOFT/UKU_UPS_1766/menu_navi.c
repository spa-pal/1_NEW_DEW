#include "menu_navi.h"
#include "string.h"
#include "lcd_buf_convertion.h"
#include "button_drv.h"
#include "main.h"
#include "common_func.h"
#include "LPC17xx.H" 

char lcdPointer=0;  // указывает на курсор на экране
char capt=0;		// сдвиг экрана относительно первой строки подменю
char startString=0;	// номер первой строки в подменю
char endString=MAX_MAIN_MENU;		// номер последней строки в подменю
int menuPointer=0;	// указатель пункта меню
menu_enum menu=mainMnu;	 //вариации переходов при butD_ в зависимости от нахождении в подменю 
char* month[12]={"янв","фев","мар","апр","май","июн","июл","авг","сен","окт","ноя","дек"};
char* Menu[300]=
				{
// ---главное меню---
" В работе      &ист.",
"Работа без батарей  ",
"Uн= 0.&В     Iн=0.&А",
"22:16:54   16/апр/00",				
"БПС №1              ",
"БПС №2              ",
"БПС №3              ",
"Сеть                ",
"Нагрузка            ",
"Датчики             ",
"Вентилятор          ",
"Электроснабжение    ",
"Спецфункции         ",
"Установки           ",
"Журнал событий      ",
"Выход               ",
"Журнал батареи №1   ",
"Журнал батареи №2   ",
"Тест                ",
//входы в подменю из главного-------------------------------------------------------------
//---меню П5---
"       БПС№1        ",
"     в работе       ",
"Uист=          55.1В",
"Iист=           3.6А",
"tист=           33°С",
"Сброс аварий        ",
"Выход               ",
//---меню П6---
"       БПС№2        ",
"     в работе       ",
"Uист=          55.1В",
"Iист=           3.6А",
"tист=           33°С",
"Сброс аварий        ",
"Выход               ",
//---меню П7---
"       БПС№3        ",
"     в работе       ",
"Uист=          55.1В",
"Iист=           3.6А",
"tист=           33°С",
"Сброс аварий        ",
"Выход               ",
//---меню П8---
"        СЕТЬ        ",
"U=                0D",
"f=             0.0Гц",
"Выход               ",
//---меню П9---
"      НАГРУЗКА      ",
"Uнаг=             0В",
"Iнаг=           0.0А",
"Выход               ",
//---меню П10---
"  ВНЕШНИЕ ДАТЧИКИ   ",
"tвнеш.возд.  неиспр.",
"tотсек ЭПУ   неиспр.",
"tотсек MSAN  неиспр.",
"tбат1        неиспр.",
"tбат2        неиспр.",
"Датч.двери     ОТКР.",
"Датч.дыма      НОРМА",
"Датч.удара     НОРМА",
"Выход               ",
//---меню П11---
"     ВЕНТИЛЯТОР     ",
"Fвент.текущ.      0%",
"Fвент.max.   (50%) 1",
"Выход               ",
//---меню П12---
"  ЭЛЕКТРОСНАБЖЕНИЕ  ",
"Ввод              0В",
"ПЭС               0В",
"Pсум.      0.00кВт*ч",
"Pтекущ.          0Вт",
"Выход               ",
//---меню П13---
"    СПЕЦФУНКЦИИ     ",
"Выр. заряд          ",	 //
"Авт. выр. заряд     ",	 //
"К.Е. батареи №1     ",	 //
"К.Е. батареи №2     ",	 //
"Выход               ",
//---меню П14---   184
"      УСТАНОВКИ   & ",
"Стандартные         ",	 //
"Время и дата        ",	 //
"Структура           ",	 //
"Климатконтроль      ",	 //
"Выход               ",
"Мнемоника через 3&с.",
"Звук. сигналы   ВЫКЛ",
"Отключение сигнала  ",
"аварий          РУЧН",
"АПВ источников      ",	 //
"Паралл работа   ВКЛ ",
"Т пров цепи бат 6&м ",
"Umax=        100.&В ",
"dU=           20.&В ",
"Uб0°=         56.&В ",
"Uб20°=        54.&В ",
"Uсигн=          4&В ",
"Umin сети=     18&В ",
"U0б=          54,&В ",
"Iбк=          0.0&А ",
"Iз max=       16.&В ",
"Imax=         10.&А ",
"Kimax=          0&8 ",
"Квыр.зар.=    1.03& ",
"Тз.вкл.а.с.      &с ",
"tи max=        8&°C ",
"tи сигн=       7&°C ",
"tбат max=      8&°C ",
"tбат сигн=     7&°C ",
"Внешние датчики     ",	  //
"Адрес счетчика   554",
"Контроль средней    ",
"точки батареи    10%",
"Серийный №        -1",
"Выход               ",
"Калибровки          ",	  //
//---меню П15---
"   ЖУРНАЛ СОБЫТИЙ   ",
"ПС      15:11:00    ",
"Вкл     15:11:00    ",
"Вкл     15:11:00    ",
"Выход               ",
"Очистить журнал     ",
//---меню П16---
//выход
//---меню П17---
"  ЖУРНАЛ БАТАРЕИ №1 ",
"Выведена  02/   /00 ",
"Номин. ёмк.     9А*ч",
"Наработка         0ч",
"Контроль ёмкости    ",
"Выравнивающий заряд ",
"Разряды             ",
"Выход               ",
//---меню П18---
"  ЖУРНАЛ БАТАРЕИ №2 ",
"Выведена  02/   /00 ",
"Номин. ёмк.     9А*ч",
"Наработка         0ч",
"Контроль ёмкости    ",
"Выравнивающий заряд ",
"Разряды             ",
"Выход               ",
//---меню П19---
"        ТЕСТ        ",
"Реле аварии         ",
"сети           РАБОЧ",
"Реле освещения РАБОЧ",
"Реле отключания",
"нагрузки       РАБОЧ",
"Перемешивающий",
"вентилятор     РАБОЧ",
"Реле аварий",
"общее          РАБОЧ",
"Приточный", 
"вентилятор     РАБОЧ",
"Реле", 
"самокалибровки РАБОЧ",
"Реле бат.№1    РАБОЧ",
"Реле бат.№2    РАБОЧ",
"БПС№1               ",	//
"БПС№2               ",	//
"БПС№3               ",	//
"Сброс               ",
"Сброс платы расш.  0",
"Выход               ",
//--------------------------------------------------------------------------------
// СПЕЦФУНКЦИИ
//--------------------------------------------------------------------------------
//---меню П13-П2---	126
"ВЫРАВНИВАЮЩИЙ ЗАРЯД ",
"Длительность      1ч",
"Выключен            ",
"Выход               ",
//---меню П13-П3---
"   АВТОМАТИЧЕСКИЙ   ",
"ВЫРАВНИВАЮЩИЙ ЗАРЯД ",
"выключен            ",
"Длительность      1ч",
"очередное включение ",
"22/май/09   16:17:18",
"Выход               ",
//---меню П13-П4---	 125
"  КОНТРОЛЬ ЕМКОСТИ  ",
"     БАТАРЕИ №1     ",
"Выключен            ",
"Выход               ",
//---меню П13-П5---  125
"  КОНТРОЛЬ ЕМКОСТИ  ",
"     БАТАРЕИ №1     ",
"Выключен            ",
"Выход               ",
//------------------------------------------------------------------
//УСТАНОВКИ
//------------------------------------------------------------------
//---меню П14-П2---
" СТАНДАРТНЫЕ УСТ-КИ ",
"ИБЭП220/48-40А      ",
"ИБЭП220/48-60А      ",
"Выход               ",
//---меню П14-П3---
"УСТАНОВКА время-даты",
"22:16:54   16/апр/00",				
"Менять: <> ^v    &  ",
"Нажмите * для выхода",
//---меню П14-П4---
"     СТРУКТУРА      ",
"Батарей            0",
"Источников         0",
"Выход               ",
//---меню П14-П5---
"   КЛИМАТКОНТРОЛЬ   ",
"tшк.max=         0°С",
"tвент.max=       0°С",
"tшк.рег.=        0°С",
"tоткл.нагр.=     0°С",
"tвкл.нагр.=      0°С",
"tоткл.бат.=      0°С",
"tвкл.нагр.=      0°С",
"Выход               ",
//---меню П14-П11---
"   АПВ ИСТОЧНИКОВ   ",
"АПВ 1й уровень   ВКЛ",
"АПВ 1й уровень   ВКЛ",
"Период АПВ2       1ч",
"Выход               ",
//---меню П14-П32--- 
"  ВНЕШНИЕ ДАТЧИКИ   ",
"Датчик двери        ",	//
"Датчик дыма         ",	//
"Датчик удара        ",	//
"Выход               ",
//---меню П14-П38---  873
"     КАЛИБРОВКА     ",	
"Сеть                ",	//
"БПС                 ",	//
"Нагрузка            ",	//
"Выход               ",
//--------------------------------------------------------------------------------
// ТЕСТ
//--------------------------------------------------------------------------------
//---меню П19-П17---
"ТЕСТ БПС №1",
"Включен",
"ШИМ",
"U = 0.0В    I = 0.0А",
"Выход               ",
//---меню П19-П18---  
"ТЕСТ БПС №1",
"Включен",
"ШИМ",
"U = 0.0В    I = 0.0А",
"Выход               ",
//---меню П19-П19---  
"ТЕСТ БПС №1",
"Включен",
"ШИМ",
"U = 0.0В    I = 0.0А",
"Выход               "

};

			



char time_buf[20]="22:16:54   16/апр/00";	 // буфер для склеивания даты и времени
char counter=0;
void menuNavi(void)
{

if (menu==mainMnu)
{

//---------- навигация по структуре главного меню
// первая строка не перемещается и не участвует в обработке, т.к. информационная
//перемещение только между 3х строк начиная с кадра № 3
if(butt_on==butU)
	{
	if(menuPointer==5)
	{
	capt=0;
	lcdPointer=0;
	} 
	if(lcdPointer>2) lcdPointer--;
	else if (capt>3) capt--;
	}
if(butt_on==butD)					              // при нажатиии кнопки вниз
	{											  // смещаем указатель, если он не вышел за рамки экрана
	if(lcdPointer==0)
	{
	lcdPointer++;				  // указатель начинает смещаться со второй строки, т.к. первая тока информационная
	capt=3;						  // пропускаем остальные не значащие инф строки
	}
	if(lcdPointer<4) lcdPointer++;				  // привыходе указателя за рамки экрана, смещаем кадр изображения строк
	else if (menuPointer<MAX_MAIN_MENU) capt++;	  // прекращаем операции смещения при достижении конца меню
	}
if(butt_on==butU_)
	{
	lcdPointer=2;
	capt=3;
	}
if(butt_on==butD_)
	{
	lcdPointer=4;
	capt=9;
	}
if(butt_on==butL)
	{
	lcdPointer=0;
	capt=0;
	}
menuPointer=capt+lcdPointer;					   // вычисление абс указателя меню
writeLCD_buffer();

}
else   //---------- навигация по структуре подменю
{
//---------------------------------------------------------------
// Здесь описываем на какую строчку перескакивать при длинном нажатии вниз в подменю кроме гл меню
//---------------------------------------------------------------

switch (menu)		  // предопределенные действия нажатие вниз вверх в зависимости от подменю
	{
	case P14menu:
		{
		if(butt_on==butU)
			{
			if(lcdPointer>2) lcdPointer--;
			else if (menuPointer-startString>2) capt--;
			}
		if(butt_on==butD)					                   // при нажатиии кнопки вниз
			{
			if(lcdPointer<4) lcdPointer++;					   // привыходе указателя за рамки экрана, смещаем кадр изображения строк
			else if (menuPointer<endString+1) capt++;	   		// прекращаем операции смещения при достижении конца меню
			}
		if(butt_on==butU_)
			{
			lcdPointer=2;
			capt=0;
			}
		if(butt_on==butD_)
			{
			lcdPointer=4;
			capt=25;
			}
		break;
		}
	case P14P3menu:
		{
		break;
		}
	default:				 // по дефаулту переход по D_ в конец меню
		{
		if(butt_on==butU)
			{
			if(lcdPointer>2) lcdPointer--;
			else if (menuPointer-startString>2) capt--;
			}
		if(butt_on==butD)					                   // при нажатиии кнопки вниз
			{
			if(lcdPointer<4) lcdPointer++;					   // привыходе указателя за рамки экрана, смещаем кадр изображения строк
			else if (menuPointer<endString+1) capt++;	   		// прекращаем операции смещения при достижении конца меню
			}
		if(butt_on==butU_)
			{
			lcdPointer=2;
			capt=0;
			}

		if(butt_on==butD_)
			{
			lcdPointer=4;
			capt=endString-4;
			}
		}
	}

menuPointer=startString+capt+lcdPointer;					   // вычисление абс указателя меню
writeLCD_buffer ();

}

}

void writeLCD_buffer (void)			  // записываем инфу из меню + сонвертированные значения
{

char k=0,flag=0,str=0,i=0,tcapt=0;
#define QofVar 2		// макс кол-во переменных отбражаемых в строке
int var[QofVar]= {0,0};

//--------- вывод даты и времени
if (!menuPointer||menuPointer==MAX_P14_P3_MENU+1)
{
takeApart_int(LPC_RTC->SEC);
counter++;
if (dig[0]!=time_buf[7]) 		 // при новом значении секунд, обнуляем счетчик и рисуем в буфер :
	{
	counter=0;
	strncpy((time_buf+5),":",1);
	strncpy((time_buf+2),":",1);
	}
if (counter==5)					 // после 0,5 сек гасим в буфере :
	{
	strncpy((time_buf+5)," ",1);
	strncpy((time_buf+2)," ",1);
	}
strncpy(time_buf+7,dig,1);
strncpy((time_buf+6),dig+1,1);

takeApart_int(LPC_RTC->MIN);
strncpy((time_buf+4),dig,1);
strncpy((time_buf+3),dig+1,1);

takeApart_int(LPC_RTC->HOUR);
strncpy((time_buf+1),dig,1);
strncpy((time_buf+0),dig+1,1);

takeApart_int(LPC_RTC->YEAR);
strncpy((time_buf+19),dig,1);
strncpy((time_buf+18),dig+1,1);

strncpy((time_buf+14),month[(LPC_RTC->MONTH)-1],3);

takeApart_int(LPC_RTC->DOM);
strncpy((time_buf+12),dig,1);
strncpy((time_buf+11),dig+1,1);

//Menu[3+(menuPointer/MAX_P15_MENU)*(MAX_P15_MENU-1)]=time_buf;
if (!menuPointer)Menu[3]=time_buf;
else Menu[MAX_P15_MENU+1]=time_buf;
}
//-----------------------------------


for(str=0;str<=3;str++)
	{
	if (str==0)	tcapt=0;	// заполнение буфера всегда первой строкой подменю
	else  tcapt=capt;
	strcpy((*lcd_buffer)+21*str,Menu[startString+str+tcapt]);  // заполнение буфера строками меню из кадра


//---------------------------------------------------------------
// Здесь описываем какие переменные должны отображаться на строке
//---------------------------------------------------------------

	switch (startString+str+tcapt)		  // определение переменных на вывод для определенной строки
		{
		case 0:
			{
			var[0]=menuPointer;
			var[1]=lcdPointer;
			break;
			}
		default:				  
			{
			var[0]=menuPointer;
			var[1]=0;
			}
		}	
i=0;
while(find('&',str)!=(LCD_SIZE/4)-1)  // выполнять пока не заменили все спец символы, т.е. не дошли до конца строки при поиске
	{
	if (i==QofVar) break;				// если ко-во спец символов превысило кол-во переменных
	takeApart_int(var[i]);
	for (k=0;k<10;k++)						// перебор всех 10 знаков числа
		{
		if (k==9) flag=1;				   // если значение переменной все нули, то уст флаг чтобы отобразить этот ноль
		if ((dig[9-k])-0x30||flag)	   // проскакиваем пока не встретили первый не нулевой символ в числе
			{
			strncpy((*lcd_buffer)+21*str+find('&',str)-9+k,dig+9-k,1); // начинаем запись с первой значащей цифры числа dig
			flag=1;									   // устанавливаем флаг, чтоб не пропустить остальные значащие нули
			}
		}
	flag=0;
	i++;
	}	
	
	
	}
}

